## dts/bindings/behaviors/zmk,behavior-caps-word-de.yaml
```yaml
description: German caps_word behavior that capitalizes umlauts

compatible: "zmk,behavior-caps-word-de"

include: zero_param.yaml

binding-cells: <0>

properties:
  continue-list:
    type: array
```
